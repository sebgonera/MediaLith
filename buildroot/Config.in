## buildroot/Config.in
```kconfig
source "$BR2_EXTERNAL_PLEXOS_PATH/package/plexos-gpu/Config.in"
source "$BR2_EXTERNAL_PLEXOS_PATH/package/plexos-init/Config.in"
source "$BR2_EXTERNAL_PLEXOS_PATH/package/plexos-plex-keyring/Config.in"
source "$BR2_EXTERNAL_PLEXOS_PATH/package/plexos-systemd-boot/Config.in"
source "$BR2_EXTERNAL_PLEXOS_PATH/package/plexosd/Config.in"
```

## buildroot/package/plexos-gpu/Config.in
```kconfig
config BR2_PACKAGE_PLEXOS_GPU
	bool "plexos-gpu"
	depends on BR2_x86_64
	select BR2_PACKAGE_LIBVA_UTILS
	help
	  Hardware transcoding diagnosis: enumerates DRM render nodes,
	  identifies the GPU, checks that the right VA-API driver and the
	  GuC/HuC firmware actually loaded, and says what to do when they
	  did not.

	  This is the tool the project exists for. The failure it addresses
	  is Plex falling back to software transcoding with nothing in any
	  log explaining why (ARCHITECTURE.md section 6).

	  It shells out to vainfo, which is why libva-utils is selected here
	  rather than merely assumed to be in the image.
```

## buildroot/package/plexos-init/Config.in
```kconfig
config BR2_PACKAGE_PLEXOS_INIT
	bool "plexos-init"
	depends on BR2_x86_64
	help
	  MediaLith PID 1: sets up dm-verity over the /usr image, assembles
	  the root filesystem, and supervises services.

	  Built as a fully static binary, which is not a preference. The
	  initrd inside the Unified Kernel Image is this one file and
	  nothing else -- no dynamic loader, no libc, no modules
	  (ARCHITECTURE.md section 3). A dynamically linked build boots to
	  a panic naming a missing loader rather than the real cause.

	  Unlike every other package here, this one is compiled by the
	  workspace's own pinned Rust toolchain rather than by Buildroot.
	  Buildroot 2026.02 carries rustc 1.88 while rust-toolchain.toml
	  pins 1.94, and a static binary shares nothing with the target
	  toolchain anyway. The tradeoff is that an image build needs
	  cargo on the host; see package/plexos-init/plexos-init.mk.
```

## buildroot/package/plexos-nvidia/Config.in
```kconfig
config BR2_PACKAGE_PLEXOS_NVIDIA
	bool "plexos-nvidia (open kernel modules)"
	depends on BR2_x86_64
	depends on BR2_LINUX_KERNEL
	help
	  NVIDIA's open GPU kernel modules, built from source against the
	  kernel this image ships (ADR-0015 step 3).

	  Turing and later only. Blackwell -- an RTX 5060 among them --
	  requires the open modules rather than the proprietary ones, which
	  is the reason this is the variant worth carrying rather than a
	  compromise.

	  This builds the kernel side alone: nvidia, nvidia-modeset,
	  nvidia-uvm, nvidia-drm and nvidia-peermem. It is not enough on its
	  own to transcode. Two things are still missing and each is its own
	  step:

	    - GSP firmware, which the driver requests at runtime as
	      nvidia/<version>/gsp_ga10x.bin and is not in this source
	      tarball (ADR-0015 step 4).
	    - The proprietary userspace, which is what Plex reaches NVDEC
	      and NVENC through (ADR-0015 step 5 onwards, and the step that
	      meets the project's unchosen licence).

	  Prefixed `plexos-` deliberately: a package directory name becomes
	  its kconfig symbol, and Buildroot already has an `nvidia-driver`
	  package pinned at 390.151. Colliding with it would have kconfig
	  merge the two definitions silently, which is a trap this project
	  has already recorded once.

	  Requires CONFIG_MODULES=y, which was set to `n` for the whole life
	  of this project until ADR-0015 reversed it.

comment "plexos-nvidia needs a kernel with loadable module support"
	depends on BR2_x86_64
	depends on !BR2_LINUX_KERNEL
```

## buildroot/package/plexos-plex-keyring/Config.in
```kconfig
config BR2_PACKAGE_PLEXOS_PLEX_KEYRING
	bool "plexos-plex-keyring"
	select BR2_PACKAGE_GNUPG2
	select BR2_PACKAGE_GNUPG2_GPGV
	help
	  Plex Inc.'s OpenPGP public key, pinned into /usr.

	  ADR-0010 has the appliance download Plex Media Server from Plex's
	  own servers at first boot and verify the signature on what
	  arrives. A key fetched at the same time as the artefact it
	  vouches for proves nothing, so this one ships in the image:
	  /usr is read-only and verified by dm-verity, which makes
	  replacing the key as hard as replacing the OS.

	  Selects gpgv, because a pinned key with nothing able to read it
	  would be an image that looks provisioned for verification and
	  silently is not.
```

## buildroot/package/plexosd/Config.in
```kconfig
config BR2_PACKAGE_PLEXOSD
	bool "plexosd"
	depends on BR2_x86_64
	help
	  MediaLith management daemon.

	  Its first job, and the reason it exists before any management API
	  does, is the boot health gate: plexosd declares a boot good, and
	  nothing else may. Until it does, the try counter in the UKI's
	  filename stands, and three failed boots hand the machine back to
	  the previous slot (ADR-0005).

	  Built by the workspace's own Rust toolchain rather than by
	  Buildroot, for the reasons set out in package/plexos-init.
```

## buildroot/package/systemd-boot/Config.in
```kconfig
config BR2_PACKAGE_SYSTEMD_BOOT
	bool "systemd-boot (standalone)"
	depends on BR2_x86_64 || BR2_aarch64 || BR2_i386
	depends on BR2_TOOLCHAIN_USES_GLIBC
	select BR2_PACKAGE_GNU_EFI
	help
	  systemd-boot, built as a plain UEFI application from systemd's
	  source, with none of systemd itself.

	  Buildroot's own BR2_PACKAGE_SYSTEMD_BOOT lives inside
	  "if BR2_PACKAGE_SYSTEMD", and that is only ever selected by the
	  BR2_INIT_SYSTEMD choice — so taking it would pull systemd in as
	  PID 1. PlexOS runs plexos-init as PID 1 and needs the bootloader
	  alone, which is what this package builds.

	  Only the EFI binary is produced. It is placed in $(BINARIES_DIR)
	  for post-image.sh to lay out on the ESP; this package installs
	  nothing into the target filesystem, since the bootloader never
	  runs from there.

	  PlexOS uses it for its boot-counting convention, which encodes a
	  try counter in the UKI filename on the ESP and decrements it by
	  renaming before handing off to the kernel. A FAT rename is the
	  closest thing to an atomic operation available that early, and it
	  avoids depending on EFI variable writes. See ADR-0005.

	  https://www.freedesktop.org/wiki/Software/systemd/systemd-boot/

if BR2_PACKAGE_SYSTEMD_BOOT

config BR2_PACKAGE_SYSTEMD_BOOT_EFI_ARCH
	string
	default "aa64" if BR2_aarch64
	default "ia32" if BR2_i386
	default "x64"  if BR2_x86_64

endif # BR2_PACKAGE_SYSTEMD_BOOT
```
